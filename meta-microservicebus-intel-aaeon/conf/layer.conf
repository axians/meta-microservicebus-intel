## meta-microservicebus-intel-aaeon/conf/layer.conf
```bitbake
# We have a conf and classes directory, add to BBPATH
BBPATH .= ":${LAYERDIR}"

# We have recipes-* directories, add to BBFILES
BBFILES += "${LAYERDIR}/recipes-*/*/*.bb \
            ${LAYERDIR}/recipes-*/*/*.bbappend"

BBFILE_COLLECTIONS += "meta-microservicebus-intel-aaeon"
BBFILE_PATTERN_meta-microservicebus-intel-aaeon = "^${LAYERDIR}/"
BBFILE_PRIORITY_meta-microservicebus-intel-aaeon = "6"

LAYERDEPENDS_meta-microservicebus-intel-aaeon = "core"
LAYERSERIES_COMPAT_meta-microservicebus-intel-aaeon = "dunfell"
```
